## configs/cameras/wyze_hms_t31x_eth_rtl8189ftv/wyze_hms_t31x_eth_rtl8189ftv_defconfig
```kconfig
# NAME: Wyze Sense Hub GW3U (T31X, SBC, ETH, RTL8188)
# FRAG: soc-xburst1 core ssl
BR2_ETHERNET=y
BR2_PACKAGE_THINGINO_KOPT_DWC2=y
BR2_PACKAGE_THINGINO_KOPT_DWC2_OTG=y
BR2_PACKAGE_THINGINO_KOPT_JZ_MAC_V13=y
BR2_PACKAGE_THINGINO_KOPT_MMC0=y
BR2_PACKAGE_THINGINO_KOPT_MMC0_PB_4BIT=y
BR2_PACKAGE_THINGINO_KOPT_MMC1=y
BR2_PACKAGE_THINGINO_KOPT_MMC1_PB_4BIT=y
BR2_PACKAGE_WIFI=y
BR2_PACKAGE_WIFI_RTL8189FS=y
BR2_PACKAGE_USBNET=y
BR2_PACKAGE_SELECT_STRACE=y
BR2_INGENIC_SOC_MODEL="t31x"
BR2_THINGINO_AUDIO=y
BR2_THINGINO_AUDIO_GPIO=63
BR2_THINGINO_BUTTON=y
BR2_THINGINO_RMEM_MB=0
BR2_THINGINO_LED_R_GPIO=8
BR2_PACKAGE_THINGINO_KOPT_UART=y
BR2_PACKAGE_THINGINO_KOPT_UART_UART0=y
BR2_PACKAGE_THINGINO_KOPT_UART_UART2=y
BR2_THINGINO_DFU=y
BR2_THINGINO_DEV_SBC=y
BR2_PACKAGE_THINGINO_KOPT_UART_UART1=y
BR2_PACKAGE_GATEWAYD=y
BR2_PACKAGE_THINGINO_MOSQUITTO_20X_BROKER=y
BR2_PACKAGE_INGENIC_AUDIODAEMON=y
```

## package/gatewayd/Config.in
```kconfig
config BR2_PACKAGE_GATEWAYD
	bool "Wyze Sense Hub CC1310 radio daemon (gatewayd)"
	help
	  CC1310 sub-1GHz radio daemon for Wyze Sense Hub GW3U.
	  Reads sensor data from CC1310 via UART and publishes
	  to MQTT on localhost (gateways/# topics with HA auto-discovery).
	  Requires mosquitto (included in core config).
```
